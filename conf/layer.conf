## conf/layer.conf
```bitbake
# Copyright (C) 2024-2026 ClearCode Inc.
# SPDX-License-Identifier: MIT

BBPATH .= ":${LAYERDIR}"

BBFILES += " \
    ${LAYERDIR}/recipes-*/*/*.bb \
    ${LAYERDIR}/recipes-*/*/*.bbappend \
"

BBFILE_COLLECTIONS += "rz-browser"
BBFILE_PATTERN_rz-browser = "^${LAYERDIR}/"
BBFILE_PRIORITY_rz-browser = "6"
BBFILES_DYNAMIC += " \
    meta-rz-bsp:${LAYERDIR}/dynamic-layers/meta-rz-bsp/recipes-*/*/*.bb \
    meta-rz-bsp:${LAYERDIR}/dynamic-layers/meta-rz-bsp/recipes-*/*/*.bbappend \
    meta-rz-distro:${LAYERDIR}/dynamic-layers/meta-rz-distro/recipes-*/*/*.bb \
    meta-rz-distro:${LAYERDIR}/dynamic-layers/meta-rz-distro/recipes-*/*/*.bbappend \
    meta-rz-graphics:${LAYERDIR}/dynamic-layers/meta-rz-graphics/recipes-*/*/*.bb \
    meta-rz-graphics:${LAYERDIR}/dynamic-layers/meta-rz-graphics/recipes-*/*/*.bbappend \
    meta-rz-codecs:${LAYERDIR}/dynamic-layers/meta-rz-codecs/recipes-*/*/*.bb \
    meta-rz-codecs:${LAYERDIR}/dynamic-layers/meta-rz-codecs/recipes-*/*/*.bbappend \
    meta-rz-codecs:${LAYERDIR}/dynamic-layers/meta-panfrost/recipes-*/*/*.bb \
    meta-rz-codecs:${LAYERDIR}/dynamic-layers/meta-panfrost/recipes-*/*/*.bbappend \
"

LAYERSERIES_COMPAT_rz-browser = "scarthgap"

LAYERDEPENDS_rz-browser = "chromium-browser-layer"
```
